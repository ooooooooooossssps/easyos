## boards/acd52832/Kconfig
```kconfig
config BOARD
    default "acd52832" if BOARD_ACD52832

config BOARD_ACD52832
    bool
    default y
    select BOARD_COMMON_NRF52
    select CPU_MODEL_NRF52832XXAA
    select HAS_PERIPH_I2C
    select HAS_PERIPH_SPI
    select HAS_PERIPH_UART

    select HAVE_SAUL_GPIO

source "$(RIOTBOARD)/common/nrf52xxxdk/Kconfig"
```

## boards/adafruit-clue/Kconfig
```kconfig
config BOARD
    default "adafruit-clue" if BOARD_ADAFRUIT_CLUE

config BOARD_ADAFRUIT_CLUE
    bool
    default y
    select BOARD_COMMON_NRF52
    select CPU_MODEL_NRF52840XXAA
    select HAS_PERIPH_I2C
    select HAS_PERIPH_SPI
    select HAS_PERIPH_UART
    select HAS_PERIPH_USBDEV
    select HAS_HIGHLEVEL_STDIO

    select HAVE_APDS9960
    select HAVE_BMP280_I2C
    select HAVE_ILI9341
    select HAVE_LIS3MDL
    select HAVE_SAUL_GPIO
    select HAVE_SHT3X

source "$(easyosBOARD)/common/nrf52/Kconfig"
Footer
```

## boards/adafruit-itsybitsy-m4/Kconfig
```kconfig
config BOARD
    default "adafruit-itsybitsy-m4" if BOARD_ADAFRUIT_ITSYBITSY_M4

config BOARD_ADAFRUIT_ITSYBITSY_M4
    bool
    default y
    select CPU_MODEL_SAMD51G19A
    select HAS_HIGHLEVEL_STDIO
    select HAS_PERIPH_DAC
    select HAS_PERIPH_ADC
    select HAS_PERIPH_I2C
    select HAS_PERIPH_RTC
    select HAS_PERIPH_RTT
    select HAS_PERIPH_PWM
    select HAS_PERIPH_SPI
    select HAS_PERIPH_TIMER
    select HAS_PERIPH_UART
    select HAS_PERIPH_USBDEV
    select HAVE_SAUL_GPIO

    select HAVE_MTD_SPI_NOR
    # This specific board requires SPI_ON_QSPI for the MTD_SPI_NOR
    select MODULE_PERIPH_SPI_ON_QSPI if MODULE_MTD_SPI_NOR

source "$(easyosBOARD)/common/samdx1-arduino-bootloader/Kconfig"
```
